## sdkconfig.defaults
```kconfig
# Gemeinsame Einstellungen fuer alle Chips
CONFIG_ESPTOOLPY_FLASHSIZE_4MB=y
CONFIG_PARTITION_TABLE_CUSTOM=y
CONFIG_PARTITION_TABLE_CUSTOM_FILENAME="partitions.csv"
CONFIG_COMPILER_OPTIMIZATION_SIZE=y

CONFIG_BT_ENABLED=y
CONFIG_BT_BTU_TASK_STACK_SIZE=4512
CONFIG_BT_BLE_42_FEATURES_SUPPORTED=y
CONFIG_BT_BLE_50_FEATURES_SUPPORTED=n

CONFIG_BLE_MESH=y
CONFIG_BLE_MESH_PROVISIONER=y
CONFIG_BLE_MESH_PB_ADV=y
CONFIG_BLE_MESH_PB_GATT=n
CONFIG_BLE_MESH_SETTINGS=y
CONFIG_BLE_MESH_SEQ_STORE_RATE=64
CONFIG_BLE_MESH_IVU_RECOVERY_IVI=y
CONFIG_BLE_MESH_TX_SEG_MSG_COUNT=10
CONFIG_BLE_MESH_RX_SEG_MSG_COUNT=10
CONFIG_BLE_MESH_CFG_CLI=y
CONFIG_BLE_MESH_GENERIC_ONOFF_CLI=y
CONFIG_BLE_MESH_LIGHT_LIGHTNESS_CLI=y
CONFIG_BLE_MESH_LIGHT_CTL_CLI=y
CONFIG_BLE_MESH_MAX_PROV_NODES=20
CONFIG_BLE_MESH_CLIENT_MSG_TIMEOUT=3000

CONFIG_ESP_COEX_SW_COEXIST_ENABLE=y
CONFIG_ESP_MAIN_TASK_STACK_SIZE=6144
CONFIG_HTTPD_MAX_REQ_HDR_LEN=1024
```

## sdkconfig.defaults.esp32
```kconfig
CONFIG_BTDM_CTRL_MODE_BLE_ONLY=y
CONFIG_BTDM_CTRL_MODEM_SLEEP=n
CONFIG_BTDM_SCAN_DUPL_TYPE_DATA_DEVICE=y
CONFIG_BTDM_BLE_MESH_SCAN_DUPL_EN=y
```

## sdkconfig.defaults.esp32c3
```kconfig
CONFIG_BT_CTRL_SCAN_DUPL_TYPE_DATA_DEVICE=y
CONFIG_BT_CTRL_BLE_MESH_SCAN_DUPL_EN=y
```
